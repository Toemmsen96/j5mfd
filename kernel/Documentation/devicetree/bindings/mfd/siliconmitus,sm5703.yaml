## kernel/Documentation/devicetree/bindings/mfd/siliconmitus,sm5703.yaml
```yaml
# SPDX-License-Identifier: GPL-2.0-only OR BSD-2-Clause
%YAML 1.2
---
$id: http://devicetree.org/schemas/mfd/siliconmitus,sm5703.yaml#
$schema: http://devicetree.org/meta-schemas/core.yaml#

title: Silicon Mitus SM5703 PMIC

maintainers:
  - Markuss Broks <markuss.broks@gmail.com>

description: |
  Silicon Mitus SM5703 is a PMIC designed for mobile phones. It contains
  LDO, buck, USB LDO and VBUS regulators, a flash LED driver, a MUIC, a fuel
  gauge and a battery charger. The MUIC and the fuel gauge have their own I2C
  addresses, while the LED driver, regulators and charger share the main I2C
  address of the device.

properties:
  compatible:
    const: siliconmitus,sm5703

  reg:
    maxItems: 1

  regulators:
    $ref: /schemas/regulator/siliconmitus,sm5703-regulator.yaml
    description:
      List of child nodes that specify the regulators.

  reset-gpios:
    description:
      GPIO connected to the active-low MRSTB (manual reset) pin.
    maxItems: 1

required:
  - compatible
  - reg
  - regulators

additionalProperties: false

examples:
  - |
    #include <dt-bindings/gpio/gpio.h>
    i2c {
        #address-cells = <1>;
        #size-cells = <0>;

        pmic@49 {
            compatible = "siliconmitus,sm5703";
            reg = <0x49>;

            reset-gpios = <&tlmm 24 GPIO_ACTIVE_LOW>;

            regulators {
                ldo1 {
                    regulator-min-microvolt = <2800000>;
                    regulator-max-microvolt = <2800000>;
                };

                ldo3 {
                    regulator-min-microvolt = <3000000>;
                    regulator-max-microvolt = <3000000>;
                };

                usbldo1 {
                    regulator-always-on;
                };
            };
        };
    };
...
```
